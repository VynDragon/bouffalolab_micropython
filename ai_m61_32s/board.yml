## ai_m61_32s/board.yml
```yaml
board:
  name: ai_m61_32s
  full_name: Ai-Thinker M61-32S development board
  vendor: aithinker
  socs:
    - name: bl618m65q2i
```

## west.yml
```yaml
manifest:
  remotes:
    - name: VynDragon
      url-base: https://github.com/VynDragon

  projects:
    - name: zephyr
      remote: VynDragon
      revision: future_bflb
      import:
        name-allowlist:
          - hal_bouffalolab
          - littlefs
    - name: micropython
      remote: VynDragon
      revision: future_bouffalolab
```
